// SPDX-License-Identifier: (GPL-2.0+ OR BSD-3-Clause)
/*
 * DEVSOC-01.6 board device tree source
 *
 * Copyright (c) 2020-2021 The Linux Foundation. All rights reserved.
 * Copyright (c) 2022 Qualcomm Innovation Center, Inc. All rights reserved.
 */

/dts-v1/;

#include "devsoc-01.4.dts"

#ifdef __IPQ_MEM_PROFILE_512_MB__
#include "devsoc-512MB-memory.dtsi"
#else
#include "devsoc-default-memory.dtsi"
#endif

/ {
	model = "Qualcomm Technologies, Inc. DevSoC/AP-DEVSOC01.6";
	compatible = "qcom,devsoc-ap-devsoc01.6", "qcom,devsoc";
};
